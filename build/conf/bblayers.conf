## build/conf/bblayers.conf
```bitbake
# This template file was created by taking the oe-core/meta/conf/bblayers.conf
# file and removing the BBLAYERS section at the end.

# LAYER_CONF_VERSION is increased each time build/conf/bblayers.conf
# changes incompatibly
LCONF_VERSION = "7"

BBPATH = "${TOPDIR}"
BBFILES ?= ""

# Layers configured by oe-core-setup script
BBLAYERS += " \
	/home/osboxes/bbx15/tisdk/sources/meta-processor-sdk \
	/home/osboxes/bbx15/tisdk/sources/meta-sdr \
	/home/osboxes/bbx15/tisdk/sources/meta-ros \
	/home/osboxes/bbx15/tisdk/sources/meta-arago/meta-arago-distro \
	/home/osboxes/bbx15/tisdk/sources/meta-arago/meta-arago-extras \
	/home/osboxes/bbx15/tisdk/sources/meta-browser \
	/home/osboxes/bbx15/tisdk/sources/meta-openamp \
	/home/osboxes/bbx15/tisdk/sources/meta-qt5 \
	/home/osboxes/bbx15/tisdk/sources/meta-openembedded/meta-networking \
	/home/osboxes/bbx15/tisdk/sources/meta-openembedded/meta-ruby \
	/home/osboxes/bbx15/tisdk/sources/meta-openembedded/meta-python \
	/home/osboxes/bbx15/tisdk/sources/meta-openembedded/meta-oe \
	/home/osboxes/bbx15/tisdk/sources/meta-openembedded/meta-gnome \
	/home/osboxes/bbx15/tisdk/sources/meta-openembedded/meta-multimedia \
	/home/osboxes/bbx15/tisdk/sources/meta-ti \
	/home/osboxes/bbx15/tisdk/sources/meta-linaro/meta-linaro-toolchain \
	/home/osboxes/bbx15/tisdk/sources/meta-linaro/meta-optee \
	/home/osboxes/bbx15/tisdk/sources/oe-core/meta \
"
```
